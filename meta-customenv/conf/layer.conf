## meta-customenv/conf/layer.conf
```bitbake
# We have a conf and classes directory, add to BBPATH
BBPATH .= ":${LAYERDIR}"

# We have recipes-* directories, add to BBFILES
BBFILES += "${LAYERDIR}/recipes-*/*/*.bb \
            ${LAYERDIR}/recipes-*/*/*.bbappend"

BBFILE_COLLECTIONS += "meta-customenv"
BBFILE_PATTERN_meta-customenv = "^${LAYERDIR}/"
BBFILE_PRIORITY_meta-customenv = "6"

LAYERDEPENDS_meta-customenv = "core"
LAYERSERIES_COMPAT_meta-customenv = "kirkstone"
```
